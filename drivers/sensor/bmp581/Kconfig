## drivers/sensor/bmp581/Kconfig
```kconfig
#
# Copyright (c) 2022 Badgerd Technologies B.V and its affiliates
#
# SPDX-License-Identifier: Apache-2.0
#

menuconfig BMP581
	bool "BMP581"
	depends on I2C && GPIO
	help
	  Enable BMP581 altitude sensor
```
